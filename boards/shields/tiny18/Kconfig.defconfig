## boards/shields/tiny18/Kconfig.defconfig
```kconfig
if SHIELD_TINY18_R

config ZMK_KEYBOARD_NAME
    default "tiny18"

config ZMK_BLE
    default y

config ZMK_SPLIT_ROLE_CENTRAL
    default y

endif

if SHIELD_TINY18_R || SHIELD_TINY18_L


config ZMK_SPLIT
    default y

config INPUT
    default y

config ZMK_POINTING
    default y

config RGBLED_WIDGET_BATTERY_LEVEL_HIGH
    default 30

config RGBLED_WIDGET_BATTERY_LEVEL_CRITICAL
    default 10

# トラックボール有効化
config ZMK_POINTING
    default y

config ZMK_MOUSE
    default y

config AZ1UBALL
    default y

config I2C
    default y

config LOG
    default y

config AZ1UBALL_LOG_LEVEL
    default 4

endif
```

## config/west.yml
```yaml
manifest:
  remotes:
    - name: zmkfirmware
      url-base: https://github.com/zmkfirmware
    - name: k3peta
      url-base: https://github.com/k3peta
    - name: caksoylar
      url-base: https://github.com/caksoylar
    # az1uballドライバー追加
    - name: kzyz
      url-base: https://github.com/kzyz
  
  projects:
    - name: zmk
      remote: zmkfirmware
      revision: main
      import: app/west.yml
    - name: zmk-rgbled-widget
      remote: caksoylar
      revision: main
    # az1uballドライバー追加
    - name: zmk-az1uball-driver
      remote: kzyz
      revision: main
  self:
    path: config
```
